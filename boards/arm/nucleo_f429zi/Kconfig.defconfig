## boards/arm/nucleo_f429zi/Kconfig.defconfig
```kconfig
# NUCLEO-144 F429ZI board configuration

# Copyright (c) 2017 Linaro Limited
# SPDX-License-Identifier: Apache-2.0

if BOARD_NUCLEO_F429ZI

config BOARD
	default "nucleo_f429zi"

config UART_3
	default y
	depends on UART_CONSOLE

config UART_6
	default y
	depends on SERIAL

config I2C_1
	default y
	depends on I2C

config SPI_1
	default y
	depends on SPI

config PWM_STM32_1
	default y
	depends on PWM

endif # BOARD_NUCLEO_F429ZI
```

## samples/hello_world/boards/nrf9160dk_nrf9160.conf
```kconfig
CONFIG_SHELL=y
CONFIG_I2C=y
CONFIG_EEPROM=y
CONFIG_EEPROM_AT24=y
CONFIG_LOG=y
CONFIG_SHELL_LOG_BACKEND=y
```

## tests/net/sendto-iface/testcase.yaml
```yaml
common:
  depends_on: netif
tests:
  net.sendto-iface:
    min_ram: 16
    tags: net route
```
