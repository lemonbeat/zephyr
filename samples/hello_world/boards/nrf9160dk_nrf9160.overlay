/* SPDX-License-Identifier: Apache-2.0 */
&i2c2 {
	status = "okay";

	/* ft24c256a */
	eeprom0: eeprom@50 {
		compatible = "atmel,at24";
		reg = <0x50>;
		label = "EEPROM_0";
		size = <32768>;
		pagesize = <32>;
		address-width = <16>;
		timeout = <5>;
	};
};
